#include "modbus_m.h"
#include "gpio.h"
#include "stm32h7xx.h"
#include "h7_core.h"
#include "soft_timer.h"
#include "gpio.h"
#include "buffer_key.h"

/*modbus用的串口4*/
UART_HandleTypeDef huart4;
uint8_t modbus_temp;
uint8_t modbus_buffer[30];
uint8_t modbus_buffer_cnt;

// CRC 高位字节值表
static const uint8_t s_CRCHi[] = {
    0x00, 0xC1, 0x81, 0x40, 0x01, 0xC0, 0x80, 0x41, 0x01, 0xC0,
    0x80, 0x41, 0x00, 0xC1, 0x81, 0x40, 0x01, 0xC0, 0x80, 0x41,
    0x00, 0xC1, 0x81, 0x40, 0x00, 0xC1, 0x81, 0x40, 0x01, 0xC0,
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    0x80, 0x41, 0x00, 0xC1, 0x81, 0x40};
// CRC 低位字节值表
const uint8_t s_CRCLo[] = {
    0x00, 0xC0, 0xC1, 0x01, 0xC3, 0x03, 0x02, 0xC2, 0xC6, 0x06,
    0x07, 0xC7, 0x05, 0xC5, 0xC4, 0x04, 0xCC, 0x0C, 0x0D, 0xCD,
    0x0F, 0xCF, 0xCE, 0x0E, 0x0A, 0xCA, 0xCB, 0x0B, 0xC9, 0x09,
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    0x43, 0x83, 0x41, 0x81, 0x80, 0x40};

/*计算modbus的crc*/
uint16_t CRC16_Modbus(uint8_t *_pBuf, uint16_t _usLen)
{
  uint8_t ucCRCHi = 0xFF; /* 高CRC字节初始化 */
  uint8_t ucCRCLo = 0xFF; /* 低CRC 字节初始化 */
  uint16_t usIndex;       /* CRC循环中的索引 */

  while (_usLen--)
  {
    usIndex = ucCRCHi ^ *_pBuf++; /* 计算CRC */
    ucCRCHi = ucCRCLo ^ s_CRCHi[usIndex];
    ucCRCLo = s_CRCLo[usIndex];
  }
  return ((uint16_t)ucCRCHi << 8 | ucCRCLo);
}

/*modbus使用的串口初始化*/
// 选择用串口4
void modbus_hardware_init(void)
{
  /*串口GPIO初始化*/
  gpio_init_pin(GPIO_C, 10, 2, 0, 2, 1, 8); // 串口四tx
  gpio_init_pin(GPIO_C, 11, 2, 0, 2, 1, 8); // 串口四rx

  /*串口初始化*/
  __HAL_RCC_UART4_CLK_ENABLE();
  huart4.Instance = UART4;
  huart4.Init.BaudRate = 115200;
  huart4.Init.WordLength = UART_WORDLENGTH_8B;
  huart4.Init.StopBits = UART_STOPBITS_1;
  huart4.Init.Parity = UART_PARITY_NONE;
  huart4.Init.Mode = UART_MODE_TX_RX;
  huart4.Init.HwFlowCtl = UART_HWCONTROL_NONE;
  huart4.Init.OverSampling = UART_OVERSAMPLING_16;
  HAL_UART_Init(&huart4);

  __set_priority(UART4_IRQn, 3, 0);
  __enable_IRQ(UART4_IRQn);
  HAL_UART_Receive_IT(&huart4, &modbus_temp, 1);
}

/*modbus串口中断服务程序*/
void UART4_IRQHandler(void)
{
  if (UART4->ISR & 0x20) // 如果有数可读
  {
    huart4.RxISR(&huart4); // 这个是执行赋值的操作
    modbus_buffer[modbus_buffer_cnt] = modbus_temp;
    modbus_buffer_cnt++;
    hard_timer_set_point(1750); // 开始计时,1750

    UART4->RQR |= 1 << 3;                          // 清除标志位
    HAL_UART_Receive_IT(&huart4, &modbus_temp, 1); // 重启接收
  }
}

struct bit
{
  uint8_t _0 : 1;
  uint8_t _1 : 1;
  uint8_t _2 : 1;
  uint8_t _3 : 1;
  uint8_t _4 : 1;
  uint8_t _5 : 1;
  uint8_t _6 : 1;
  uint8_t _7 : 1;
} bit_temp;

uint16_t addr;
uint16_t num;

// key_mem  00地址 01地址
static void func_1(void)
{
  uint16_t *temp = (uint16_t *)modbus_buffer;
  addr = (temp[1] >> 8) | (temp[1] << 8); // 大小端转换,这里是地址
  num = (temp[2] >> 8) | (temp[2] << 8);  // 大小端转换,这里是数量
  if (num == 1)
  {
    if (is_active(addr))
      bit_temp._0 = 1;
    else
      bit_temp._0 = 0;
  }
  else if (num == 2)
  {
    if (is_active(addr))
      bit_temp._0 = 1;
    else
      bit_temp._0 = 0;
    if (is_active(addr + 1))
      bit_temp._1 = 1;
    else
      bit_temp._1 = 0;
  }
  else
  {
      return ;
  }
  modbus_buffer[2] = 1;
  modbus_buffer[3] = *(uint8_t *)&bit_temp;
  uint16_t crc_temp = CRC16_Modbus(modbus_buffer, 4);
  modbus_buffer[4] = crc_temp >> 8;
  modbus_buffer[5] = crc_temp & 0xff;
  HAL_UART_Transmit(&huart4, modbus_buffer, 6, 10);
}

static void func_2(void)
{
}
static void func_3(void)
{
}
static void func_4(void)
{
}

/*灯组*/
static gpio_group_t modbus_led_group[4] =
    {
        {GPIO_A, 0},
        {GPIO_A, 1},
        {GPIO_A, 2},
        {GPIO_A, 3},
};

/*写单个线圈操作*/
static void func_5(void)
{
  uint16_t *temp = (uint16_t *)modbus_buffer;
  uint16_t addr = (temp[1] >> 8) | (temp[1] << 8); // 大小端转换,这里是地址
  uint8_t p[6] = {0x01, 0x85,};
  uint16_t crc_temp = 0;
  if (addr > 3) // 超出地址范围地址错误
  {
    p[2]= 2;
    crc_temp = CRC16_Modbus(p, 3);
    p[3] = crc_temp >> 8;
    p[4] = crc_temp & 0xff;
    HAL_UART_Transmit(&huart4, p, 5, 10);
    return;
  }

  if (temp[2] == 0xff)
    GPIO_OUT(modbus_led_group[addr].GPIOx, modbus_led_group[addr].pin, 0);
  else if (temp[2] == 0x00)
    GPIO_OUT(modbus_led_group[addr].GPIOx, modbus_led_group[addr].pin, 1);
  else                            //数据不对错误
  {
    p[2]= 3;
    crc_temp = CRC16_Modbus(p, 3);
    p[3] = crc_temp >> 8;
    p[4] = crc_temp & 0xff;
    HAL_UART_Transmit(&huart4, p, 5, 10);
    return;
  }

  HAL_UART_Transmit(&huart4, modbus_buffer, 8, 10);
}

static void func_6(void)
{
}

static void func_15(void)
{
}

static void func_16(void)
{
}
/*指令解析*/
static void modbus_Application_analysis(void)
{
  uint8_t modbus_func_code;
#if MODBUS_PRINTF == 1 // 是否启用调试信息
  printf("单片机接收到的指令:\r\n");
  uint8_t i;
  for (i = 0; i < modbus_buffer_cnt; i++)
  {
    printf("%#x ", modbus_buffer[i]);
  }
  printf("\r\n");
#endif
  switch (modbus_buffer[1])
  {
  case 1: // 读多个线圈寄存器,类似小端
    func_1();

    break;
  case 2: // 读多个线圈寄存器,类似大端
    func_2();

    break;
  case 3: // 读多个16位寄存器,小端
    func_3();

    break;
  case 4: // 貌似也是读多个16位寄存器,小端
    func_4();

    break;
  case 5: // 写单个线圈
    func_5();

    break;
  case 6: // 写单个16bit寄存器
    func_6();

    break;
  case 15: // 写多个线圈寄存器,类似小端
    func_15();

  case 16: // 写多个16bit寄存器,小端
    func_16();
    break;
  defaul:

    break;
  }
}

/*主循环中modbus处理*/
void modbus_handle(void)
{
  uint16_t crc1;
  if (hard_timer_get_result()) // 如果还没接收到一帧
  {
    crc1 = CRC16_Modbus(modbus_buffer, modbus_buffer_cnt); // CRC校验
    if (crc1 != 0)
    {
      modbus_buffer_cnt = 0;
      return;
    }

    if (modbus_buffer_cnt < 4) // 数量
    {
      modbus_buffer_cnt = 0;
      return;
    }

    if (modbus_buffer[0] != 0x01) // 从机地址,设从机地址为0x01
    {
      modbus_buffer_cnt = 0;
      return;
    }
    modbus_Application_analysis(); // 应用解析

    modbus_buffer_cnt = 0;
  }
}
